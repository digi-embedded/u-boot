## board/digi/ccimx6sbc/Kconfig
```kconfig
if TARGET_CCIMX6QSBC || TARGET_CCIMX6DLSBC || TARGET_CCIMX6QPSBC

config SYS_BOARD
	default "ccimx6sbc"

config SYS_VENDOR
	default "digi"

config SYS_SOC
	default "mx6"

config SYS_CONFIG_NAME
	string
	default "ccimx6sbc"

source "board/digi/common/Kconfig"

endif
```

## board/digi/ccimx8mm_dvk/Kconfig
```kconfig
if TARGET_CCIMX8MM_DVK

source "board/digi/common/Kconfig"

config SYS_BOARD
	default "ccimx8mm_dvk"

config SYS_VENDOR
	default "digi"

config SYS_CONFIG_NAME
	default "ccimx8mm_dvk"

config IMX_CONFIG
	default "arch/arm/mach-imx/imx8m/imximage-8mm-lpddr4.cfg"

# Must match TARGET_BOOTLOADER_BOARD_NAME in Android
config TARGET_PRODUCT_NAME
	default "ccimx8mmdvk"

endif
```

## board/digi/ccimx8mn_dvk/Kconfig
```kconfig
if TARGET_CCIMX8MN_DVK

source "board/digi/common/Kconfig"

config SYS_BOARD
	default "ccimx8mn_dvk"

config SYS_VENDOR
	default "digi"

config SYS_CONFIG_NAME
	default "ccimx8mn_dvk"

config IMX_CONFIG
	default "board/freescale/imx8mn_evk/imximage-8mn-ddr4.cfg"

endif
```

## board/digi/ccimx8x_sbc_pro/Kconfig
```kconfig
if TARGET_CCIMX8X_SBC_PRO

source "board/digi/common/Kconfig"

config SYS_BOARD
	default "ccimx8x_sbc_pro"

config SYS_VENDOR
	default "digi"

config SYS_CONFIG_NAME
	default "ccimx8x_sbc_pro"

config IMX_CONFIG
	default "board/digi/ccimx8x/imximage.cfg"

# Must match TARGET_BOOTLOADER_BOARD_NAME in Android
config TARGET_PRODUCT_NAME
	default "ccimx8xsbcpro"

endif
```

## board/digi/ccimx95-dvk/Kconfig
```kconfig
if TARGET_CCIMX95_DVK

config SYS_BOARD
	default "ccimx95-dvk"

config SYS_VENDOR
	default "digi"

config SYS_CONFIG_NAME
	default "ccimx95-dvk"

source "board/digi/common/Kconfig"

endif
```

## board/digi/common/Kconfig
```kconfig
config CCMP2
	bool

config CCMP15
	bool
	select CCMP1

config CCMP13
	bool
	select CCMP1

config CCMP1
	bool

config CC8M
	bool

config CC8X
	bool

config CC6UL
	bool

config MCA
	bool "Support for the Micro Controller Assist (MCA)"

if MCA
config MCA_I2C_BUS
	int "I2C bus index where the MCA is connected to"

config MCA_I2C_ADDR
	hex "I2C address of the Micro Controller Assist (MCA)"

config MCA_OFFSET_LEN
	int "Offset length value of the I2C bus when talking to the MCA"
	default 2

config MCA_TAMPER
	bool "Support for the tamper pins of the MCA"
endif

config CMD_DBOOT
	bool "Support for Digi 'dboot' command"
	help
	  Digi custom direct boot (dboot) command comprises in a single
	  command:
	   - Download of firmware files (kernel, device tree) from the
	     specified media to RAM.
	   - Composition of boot arguments.
	   - Boot of the Operating System.

config CMD_UPDATE
	bool "Support for Digi 'update' command"
	help
	  Digi custom firmware update (update) command comprises in a single
	  command:
	   - Download of firmware image files from the specified media to RAM.
	   - Programming of the firmware file on the specified partition.
	   - Verification of the image programmed on the storage media.

	  The command also allows for on-the-fly update (transfer and write
	  chunks of the firmware image) when available RAM is small or the
	  image file is very large).

if CMD_UPDATE
config CMD_UPDATE_NAND
	bool
	default y if CCMP1
	default y if CC6UL

config CMD_UPDATE_MMC
	bool
	default y if CCMP2
	default y if CC8M
	default y if CC8X

config SYS_STORAGE_MEDIA
	string
	default "nand" if CMD_UPDATE_NAND
	default "mmc" if CMD_UPDATE_MMC

config CMD_BOOTSTREAM
	bool
	depends on CMD_UPDATE_NAND
	default y if CC6UL

config DIGI_UPDATE_ADDR
	hex "RAM address where to place the firmware image during update"
	default 0x84000000 if CCMP2
	default 0xc2000000 if CCMP1
	default 0x50000000 if CC8M
	default 0x95000000 if CC8X
	default 0x80800000 if CC6UL

config DIGI_LZIPADDR
	hex "RAM address where to place compressed image (to be decompressed)"
	default 0x94000000 if CCMP2
	default 0xc8400000 if CCMP1
	default 0x44000000 if CC8M
	default 0x8C000000 if CC8X
	default 0x82000000 if CC6UL

config OTF_CHUNK
	hex "Chunk size (in bytes) for on-the-fly (OTF) updates"
	default 0x2000000

config UBOOT_RESERVED
	hex "RAM memory reserved for U-Boot, stack, malloc pool..."
	default 0xA00000
endif

config DIGI_UBI
	bool "Support for Digi specific UBI functions"

config HAS_HWID
	bool
	default y
	help
	  Platform supports a Hardware ID (HWID) on the OTP bits.

if HAS_HWID
config HAS_OTP_LOCK_FUSE
	bool
	default y if CC6UL
	default y if CC8M

if HAS_OTP_LOCK_FUSE
config HWID_LOCK_FUSE
	hex
	default 0x100 if CC6UL
	default 0x4000 if CC8M
	help
	  HWID lock fuse mask.
endif

endif

config CUSTOM_HUK
	bool
	default y if CCMP15

config DIGI_FAMILY_ID
	int "Digi Family ID for Serial Number composition"
	default 1 if CC8X
	default 2 if CC8M && IMX8MN
	default 3 if CC8M && IMX8MM
	default 4 if CCMP1
	default 5 if CC9 && (IMX91 || IMX93)
	default 6 if CCMP2
	default 7 if CC9 && IMX95
	default 0

config MTD_UBI_MAXRSVDPEB_PCNT
	int "Percentage of MTD partition reserved for bad blocks on a UBI volume"
	default 4
	help
	  Standard U-Boot code uses a very conservative approach of reserving
	  bad blocks basing on the full NAND size, instead of the size of the
	  MTD partition. This setting allows to limit the number of reserved
	  blocks for bad block handling to a percentage of the MTD partition size.

config HAS_TRUSTFENCE
	bool
	default y if CC8X
	default y if CC8M
	default y if CC6UL
	default y if CCMP1
	default y if CCMP2

if HAS_TRUSTFENCE
config CMD_TRUSTFENCE_NXP
	bool
	default y if CC8X
	default y if CC8M
	default y if CC6UL

config CMD_TRUSTFENCE_STM
	bool
	default y if CCMP1
	default y if CCMP2
endif

config ENV_ENCRYPT
	bool "Encrypt u-boot environment using the hardware unique key (HUK)"
	select MD5
	help
	  Implementation uses CAAM or Optee depending on the platform.

	  This setting only has an effect on closed devices (those that can
	  only boot signed U-Boot images). It has no effect on open devices.

config ENV_AES_CAAM_KEY
	bool "Encrypt U-Boot environment with CAAM internal key"
	depends on HAS_CAAM
	depends on ENV_ENCRYPT
	help
	  Use the internal CAAM secure key for environment encryption which
	  uses AES-256-CCM.

	  This setting is only supported in closed devices (those which can
	  only boot signed U-Boot images). It has no effect on open devices.

config OPTEE_ENV_ENCRYPT
	bool
	depends on ENV_ENCRYPT
	depends on CCMP1 || CCMP2
	default ENV_ENCRYPT
	help
	  Encrypt U-Boot environment using Optee
```

## board/digi/common/Kconfig.trustfence
```kconfig
config TRUSTFENCE_SRK_N_REVOKE_KEYS
	int
	default 3

config TRUSTFENCE_SRK_BANK
	int
	default 16 if CC9
	default 6 if CC8M
	default 3 if CC6UL || CC6
	default 0 if CC8X

config TRUSTFENCE_SRK_WORDS
	int
	default 16 if CC8X
	default 8 if CC9 || CC8M || CC6UL || CC6

config TRUSTFENCE_SRK_WORDS_PER_BANK
	int
	default 16 if CC8X
	default 4 if CC8M
	default 8 if CC9 || CC6UL || CC6

config TRUSTFENCE_SRK_WORDS_OFFSET
	int
	default 730 if CC8X
	default 0 if CC9 || CC8M || CC6UL || CC6

if CC6 || CC6UL || CC8M || CC8X

config TRUSTFENCE_SRK_REVOKE_BANK
	int
	default 9 if CC8M
	default 5 if CC6 || CC6UL
	default 0 if CC8X

config TRUSTFENCE_SRK_REVOKE_WORD
	int
	default 11 if CC8X
	default 3 if CC8M
	default 7 if CC6 || CC6UL

config TRUSTFENCE_SRK_REVOKE_MASK
	hex
	default 0xf if CC8X
	default 0x7 if CC6 || CC6UL || CC8M

config TRUSTFENCE_SRK_REVOKE_OFFSET
	int
	default 8 if CC8X
	default 0 if CC6 || CC6UL || CC8M

endif

if CC6 || CC6UL || CC8M

config TRUSTFENCE_SRK_OTP_LOCK_BANK
	int
	default 0

config TRUSTFENCE_SRK_OTP_LOCK_WORD
	int
	default 0

config TRUSTFENCE_SRK_OTP_LOCK_OFFSET
	int
	default 9 if CC8M
	default 14 if CC6 || CC6UL

endif

config TRUSTFENCE_UPDATE
	bool
	default y if CC6 || CC6UL || CC8M || CC8X || CC9

config TRUSTFENCE_JTAG
	bool
	default y if CC6UL

config ENV_ENCRYPT
	bool "Encrypt u-boot environment using the hardware unique key (HUK)"
	select MD5
	help
	  Implementation uses CAAM or Optee depending on the platform.

	  This setting only has an effect on closed devices (those that can
	  only boot signed U-Boot images). It has no effect on open devices.

config CAAM_ENV_ENCRYPT
	bool
	depends on ENV_ENCRYPT
	depends on HAS_CAAM && !CC9
	default ENV_ENCRYPT
	help
	  Encrypt U-Boot environment using CAAM

config OPTEE_ENV_ENCRYPT
	bool
	depends on ENV_ENCRYPT
	depends on CC9
	default ENV_ENCRYPT
	help
	  Encrypt U-Boot environment using Optee
```

## board/freescale/mx6sabresd/Kconfig
```kconfig
if TARGET_MX6SABRESD || TARGET_MX6SABRESD_COMMON

config SYS_BOARD
	default "mx6sabresd"

config SYS_VENDOR
	default "freescale"

config SYS_CONFIG_NAME
	default "mx6sabresd"

endif
```

## board/nxp/imx8dxl_evk/Kconfig
```kconfig
if  TARGET_IMX8DXL_EVK || TARGET_IMX8DXL_DDR3_EVK

config SYS_BOARD
	default "imx8dxl_evk"

config SYS_VENDOR
	default "nxp"

config SYS_CONFIG_NAME
	default "imx8dxl_evk"

config IMX_CONFIG
	default "board/nxp/imx8dxl_evk/imximage.cfg"

endif
```

## board/nxp/imx8dxl_orangebox/Kconfig
```kconfig
if TARGET_IMX8DXL_ORANGEBOX

config SYS_BOARD
	default "imx8dxl_orangebox"

config SYS_VENDOR
	default "nxp"

config SYS_CONFIG_NAME
	default "imx8dxl_orangebox"

config IMX_CONFIG
	default "board/nxp/imx8dxl_orangebox/imximage.cfg"

endif
```

## board/nxp/imx8mm_evk/Kconfig
```kconfig
if TARGET_IMX8MM_EVK || TARGET_IMX8MM_DDR4_EVK

config SYS_BOARD
	default "imx8mm_evk"

config SYS_VENDOR
	default "nxp"

config SYS_CONFIG_NAME
	default "imx8mm_evk"

config IMX_CONFIG
	default "board/nxp/imx8mm_evk/imximage-8mm.cfg"

config IMX8M_1G_MEMORY
	bool "imx8m 1GB memory size"

endif
```

## board/nxp/imx8mp_frdm/Kconfig
```kconfig
if TARGET_IMX8MP_FRDM

config SYS_BOARD
	default "imx8mp_frdm"

config SYS_VENDOR
	default "nxp"

config SYS_CONFIG_NAME
	default "imx8mp_frdm"

config IMX_CONFIG
	default "board/nxp/imx8mp_frdm/imximage-8mp-lpddr4.cfg"

endif
```

## board/nxp/imx8qxp_val/Kconfig
```kconfig
if TARGET_IMX8QXP_LPDDR4_VAL || TARGET_IMX8QXP_DDR3_VAL || TARGET_IMX8X_17X17_VAL

config SYS_BOARD
	default "imx8qxp_val"

config SYS_VENDOR
	default "nxp"

config SYS_CONFIG_NAME
	default "imx8qxp_val"

config IMX_CONFIG
	default "board/nxp/imx8qxp_val/imximage.cfg"

endif
```

## board/nxp/mx6sllevk/Kconfig
```kconfig
if TARGET_MX6SLLEVK

config SYS_BOARD
	default "mx6sllevk"

config SYS_VENDOR
	default "nxp"

config SYS_CONFIG_NAME
	default "mx6sllevk"

config IMX_CONFIG
	default "board/nxp/mx6sllevk/imximage.cfg"

config TEXT_BASE
	default 0x87800000
endif
```

## configs/ccimx6qsbc512MB_defconfig
```kconfig
CONFIG_ARM=y
CONFIG_ARCH_MX6=y
CONFIG_TEXT_BASE=0x17800000
CONFIG_SYS_MALLOC_LEN=0x2000000
CONFIG_NR_DRAM_BANKS=1
CONFIG_ENV_SIZE=0x4000
CONFIG_ENV_OFFSET=0x1C0000
CONFIG_IMX_CONFIG="board/digi/ccimx6/ccimx6q512MB.cfg"
CONFIG_MX6Q=y
CONFIG_TARGET_CCIMX6QSBC=y
CONFIG_CMD_DBOOT=y
CONFIG_CMD_UPDATE=y
CONFIG_HAS_HWID=y
CONFIG_DM_GPIO=y
CONFIG_DEFAULT_DEVICE_TREE="imx6q-ccimx6sbc"
CONFIG_OF_LIBFDT_OVERLAY=y
CONFIG_ENV_OFFSET_REDUND=0x1E0000
CONFIG_IMX_HAB=y
CONFIG_CSF_SIZE=0x4000
CONFIG_SYS_MEMTEST_START=0x10000000
CONFIG_SYS_MEMTEST_END=0x10010000
# CONFIG_ANDROID_BOOT_IMAGE is not set
CONFIG_DISTRO_DEFAULTS=y
CONFIG_BOOTDELAY=1
CONFIG_OF_BOARD_SETUP=y
CONFIG_BOOTCOMMAND="if run loadscript; then source ${loadaddr}; fi"
CONFIG_DEFAULT_FDT_FILE="imx6q-ccimx6sbc.dtb"
CONFIG_SILENT_CONSOLE=y
# CONFIG_SPL_SILENT_CONSOLE is not set
# CONFIG_TPL_SILENT_CONSOLE is not set
CONFIG_SILENT_CONSOLE_UPDATE_ON_RELOC=y
CONFIG_DISPLAY_BOARDINFO_LATE=y
CONFIG_CMD_MEMTEST=y
CONFIG_CMD_GPIO=y
CONFIG_CMD_I2C=y
CONFIG_CMD_MMC=y
CONFIG_CMD_MMC_SWRITE=y
CONFIG_CMD_USB=y
CONFIG_CMD_BOOTCOUNT=y
CONFIG_CMD_CACHE=y
CONFIG_CMD_TIME=y
CONFIG_CMD_REGULATOR=y
CONFIG_CMD_EXT4_WRITE=y
# CONFIG_ISO_PARTITION is not set
CONFIG_PARTITION_TYPE_GUID=y
CONFIG_OF_CONTROL=y
CONFIG_ENV_OVERWRITE=y
CONFIG_ENV_IS_IN_MMC=y
CONFIG_SYS_REDUNDAND_ENVIRONMENT=y
CONFIG_SYS_RELOC_GD_ENV_ADDR=y
CONFIG_SYS_MMC_ENV_PART=2
CONFIG_ARP_TIMEOUT=200
CONFIG_BOUNCE_BUFFER=y
CONFIG_BOOTCOUNT_LIMIT=y
CONFIG_BOOTCOUNT_ENV=y
CONFIG_USB_FUNCTION_FASTBOOT=y
CONFIG_FASTBOOT_BUF_ADDR=0x12800000
CONFIG_FASTBOOT_BUF_SIZE=0x10000000
CONFIG_FASTBOOT_FLASH=y
CONFIG_DM_I2C=y
CONFIG_SYS_I2C_MXC=y
CONFIG_SUPPORT_EMMC_RPMB=y
CONFIG_SUPPORT_EMMC_BOOT=y
CONFIG_FSL_USDHC=y
CONFIG_PHYLIB=y
CONFIG_PHY_MICREL=y
CONFIG_PHY_MICREL_KSZ90X1=y
CONFIG_DM_ETH_PHY=y
CONFIG_FEC_MXC=y
CONFIG_MII=y
CONFIG_PINCTRL=y
CONFIG_PINCTRL_IMX6=y
CONFIG_DM_PMIC=y
CONFIG_DM_PMIC_DA9063=y
CONFIG_DM_REGULATOR=y
CONFIG_DM_REGULATOR_DA9063=y
CONFIG_DM_REGULATOR_FIXED=y
CONFIG_DM_REGULATOR_GPIO=y
CONFIG_DM_SERIAL=y
CONFIG_MXC_UART=y
CONFIG_USB=y
CONFIG_USB_GADGET=y
CONFIG_USB_GADGET_MANUFACTURER="FSL"
CONFIG_USB_GADGET_VENDOR_NUM=0x0525
CONFIG_USB_GADGET_PRODUCT_NUM=0xa4a5
CONFIG_CI_UDC=y
CONFIG_SHA256=y
```

## configs/ccimx6ulstarter_defconfig
```kconfig
CONFIG_ARM=y
CONFIG_ARCH_MX6=y
CONFIG_TEXT_BASE=0x87800000
CONFIG_SYS_MALLOC_LEN=0x1000000
CONFIG_NR_DRAM_BANKS=1
CONFIG_ENV_SIZE=0x20000
CONFIG_ENV_OFFSET=0x300000
CONFIG_MX6UL=y
CONFIG_TARGET_CCIMX6ULSTARTER=y
CONFIG_MCA_I2C_BUS=0
CONFIG_MCA_I2C_ADDR=0x7e
CONFIG_CMD_DBOOT=y
CONFIG_CMD_UPDATE=y
CONFIG_DIGI_UBI=y
CONFIG_HAS_HWID=y
CONFIG_DM_GPIO=y
CONFIG_DEFAULT_DEVICE_TREE="imx6ul-ccimx6ulstarter"
CONFIG_OF_LIBFDT_OVERLAY=y
CONFIG_ENV_OFFSET_REDUND=0x300000
CONFIG_IMX_HAB=y
CONFIG_CSF_SIZE=0x4000
CONFIG_SYS_MEMTEST_START=0x80000000
CONFIG_SYS_MEMTEST_END=0x87ffffff
CONFIG_LTO=y
# CONFIG_ANDROID_BOOT_IMAGE is not set
CONFIG_DISTRO_DEFAULTS=y
CONFIG_NAND_BOOT=y
CONFIG_BOOTDELAY=1
CONFIG_OF_BOARD_SETUP=y
CONFIG_BOOTCOMMAND="if run loadscript; then source ${loadaddr}; fi"
CONFIG_DEFAULT_FDT_FILE="imx6ul-ccimx6ulstarter.dtb"
CONFIG_SILENT_CONSOLE=y
# CONFIG_SILENT_CONSOLE_UPDATE_ON_SET is not set
CONFIG_SILENT_CONSOLE_UPDATE_ON_RELOC=y
CONFIG_DISPLAY_BOARDINFO_LATE=y
# CONFIG_BOOTM_NETBSD is not set
# CONFIG_BOOTM_PLAN9 is not set
# CONFIG_BOOTM_RTEMS is not set
# CONFIG_CMD_EXPORTENV is not set
# CONFIG_CMD_IMPORTENV is not set
CONFIG_CRC32_VERIFY=y
CONFIG_CMD_MD5SUM=y
CONFIG_CMD_MEMTEST=y
CONFIG_CMD_GPIO=y
CONFIG_CMD_I2C=y
CONFIG_CMD_MMC=y
CONFIG_CMD_NAND_TRIMFFS=y
CONFIG_CMD_USB=y
CONFIG_CMD_BOOTCOUNT=y
CONFIG_CMD_CACHE=y
CONFIG_CMD_TIME=y
CONFIG_CMD_EXT4_WRITE=y
CONFIG_CMD_MTDPARTS=y
CONFIG_MTDIDS_DEFAULT="nand0=gpmi-nand"
CONFIG_CMD_UBI=y
# CONFIG_ISO_PARTITION is not set
CONFIG_PARTITION_TYPE_GUID=y
CONFIG_OF_CONTROL=y
CONFIG_ENV_IS_IN_NAND=y
CONFIG_ENV_RANGE=0x100000
CONFIG_SYS_REDUNDAND_ENVIRONMENT=y
CONFIG_USE_ETHPRIME=y
CONFIG_ETHPRIME="eth0"
CONFIG_BOOTCOUNT_LIMIT=y
CONFIG_DM_BOOTCOUNT=y
CONFIG_DM_BOOTCOUNT_RTC=y
CONFIG_USB_FUNCTION_FASTBOOT=y
CONFIG_FASTBOOT_BUF_ADDR=0x80800000
CONFIG_FASTBOOT_BUF_SIZE=0xF000000
CONFIG_FASTBOOT_FLASH=y
CONFIG_MCA_GPIO=y
CONFIG_DM_I2C=y
CONFIG_SYS_I2C_MXC=y
CONFIG_SUPPORT_EMMC_RPMB=y
CONFIG_FSL_USDHC=y
CONFIG_MTD=y
CONFIG_NAND_MXS=y
CONFIG_NAND_MXS_USE_MINIMUM_ECC=y
CONFIG_SYS_NAND_ONFI_DETECTION=y
CONFIG_PHYLIB=y
CONFIG_DM_ETH_PHY=y
CONFIG_FEC_MXC=y
CONFIG_MII=y
CONFIG_PINCTRL=y
CONFIG_PINCTRL_IMX6=y
CONFIG_DM_PMIC=y
CONFIG_DM_PMIC_PFUZE100=y
CONFIG_DM_REGULATOR=y
CONFIG_DM_REGULATOR_PFUZE100=y
CONFIG_DM_REGULATOR_FIXED=y
CONFIG_DM_REGULATOR_GPIO=y
CONFIG_DM_RTC=y
CONFIG_RTC_MCA=y
CONFIG_SPECIFY_CONSOLE_INDEX=y
CONFIG_CONS_INDEX=5
CONFIG_DM_SERIAL=y
CONFIG_MXC_UART=y
CONFIG_IMX_THERMAL=y
CONFIG_USB=y
CONFIG_USB_HOST_ETHER=y
CONFIG_USB_ETHER_ASIX=y
CONFIG_USB_GADGET=y
CONFIG_USB_GADGET_MANUFACTURER="FSL"
CONFIG_USB_GADGET_VENDOR_NUM=0x0525
CONFIG_USB_GADGET_PRODUCT_NUM=0xa4a5
CONFIG_CI_UDC=y
CONFIG_SHA256=y
CONFIG_FSL_CAAM_RNG_ERRATA=y
CONFIG_ARCH_MISC_INIT=y
```
