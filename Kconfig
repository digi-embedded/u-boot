## arch/arm/mach-imx/imx8/Kconfig
```kconfig
if ARCH_IMX8

config HAVE_SC_FIRMWARE
	bool
	help
	  Have SCU on the SoC

config RECOVER_SPL_DATA_SECTION
	bool
	help
	  Save SPL DATA section for cold boot, restore at warm boot

config IMX_SMMU
	bool "Enable SMMU on i.MX8"
	help
	  Enable the SMMU for peripherals on i.MX8

config AHAB_BOOT
	bool "Support i.MX8 AHAB features"
	help
	  This option enables the support for AHAB secure boot.

config IMX8
	bool
	default y

config IMX8QM
	bool
	select HAVE_SC_FIRMWARE
	select RECOVER_SPL_DATA_SECTION

config IMX8QXP
	bool
	select HAVE_SC_FIRMWARE
	select RECOVER_SPL_DATA_SECTION

config SYS_SOC
	default "imx8"

config MX8_FUSE_PROG
	bool "Enable Fuse programming within U-Boot on i.MX8"
	help
	  Enable Fuse programming within U-Boot on i.MX8

config SMC_FUSE
        bool "Call fuse commands through SMC"

config IMX8_TRUSTY_XEN
	bool "Support Trusty Xen feature"

choice
	prompt "MX8 board select"
	optional

config TARGET_CCIMX8X_SBC_EXPRESS
	bool "Digi ConnectCore 8X SBC Express"
	select BOARD_LATE_INIT
	select IMX8QXP
	select MCA

config TARGET_CCIMX8X_SBC_PRO
	bool "Digi ConnectCore 8X SBC Pro"
	select BOARD_LATE_INIT
	select IMX8QXP
	select MCA

config TARGET_IMX8QM_LPDDR4_ARM2
	bool "Support i.MX8QM lpddr4 validation board"
	select BOARD_LATE_INIT
	select SUPPORT_SPL
	select IMX8QM

config TARGET_IMX8QM_DDR4_ARM2
	bool "Support i.MX8QM ddr4 validation board"
	select BOARD_LATE_INIT
	select SUPPORT_SPL
	select IMX8QM

config TARGET_IMX8QM_MEK
	bool "Support i.MX8QM MEK board"
	select BOARD_LATE_INIT
	select SUPPORT_SPL
	select IMX8QM

config TARGET_IMX8QXP_LPDDR4_ARM2
	bool "Support i.MX8QXP lpddr4 validation board"
	select BOARD_LATE_INIT
        select SUPPORT_SPL
	select IMX8QXP

config TARGET_IMX8QXP_DDR3_ARM2
	bool "Support i.MX8QXP ddr3 validation board"
	select BOARD_LATE_INIT
	select IMX8QXP

config TARGET_IMX8X_17X17_VAL
	bool "Support i.MX8QXP/DX 17x17 validation board"
	select BOARD_LATE_INIT
	select IMX8QXP

config TARGET_IMX8QXP_MEK
	bool "Support i.MX8QXP MEK board"
	select BOARD_LATE_INIT
	select SUPPORT_SPL
	select IMX8QXP

config TARGET_IMX8DX_MEK
	bool "Support i.MX8DX MEK board"
	select BOARD_LATE_INIT
	select SUPPORT_SPL
	select IMX8QXP

endchoice

source "board/digi/ccimx8x_sbc_express/Kconfig"
source "board/digi/ccimx8x_sbc_pro/Kconfig"
source "board/freescale/imx8qm_arm2/Kconfig"
source "board/freescale/imx8qm_mek/Kconfig"
source "board/freescale/imx8qxp_arm2/Kconfig"
source "board/freescale/imx8qxp_mek/Kconfig"

config SNVS_SEC_SC
	bool "Support SNVS configuration"
	help
	  Allow to configure the SNVS via SCU API to configure tampers and secure
	  violation.

config SNVS_SEC_SC_AUTO
	bool "Support SNVS configuration command"
	depends on SNVS_SEC_SC
	help
	  This configuration will apply the selected configurations automatically
	  at boot.

endif
```

## board/digi/ccimx6ulalvic/Kconfig
```kconfig
if TARGET_CCIMX6ULALVIC

source "board/digi/common/Kconfig"

config SYS_BOARD
	default "ccimx6ulalvic"

config SYS_VENDOR
	default "digi"

config SYS_SOC
	default "mx6"

config SYS_CONFIG_NAME
	default "ccimx6ulalvic"

source "board/digi/ccimx6ul/Kconfig"

endif
```

## board/digi/ccimx6ulsbc/Kconfig
```kconfig
if TARGET_CCIMX6ULSBC

source "board/digi/common/Kconfig"

config SYS_BOARD
	default "ccimx6ulsbc"

config SYS_VENDOR
	default "digi"

config SYS_SOC
	default "mx6"

config SYS_CONFIG_NAME
	default "ccimx6ulsbc"

endif
```

## board/digi/ccimx6ulstarter/Kconfig
```kconfig
if TARGET_CCIMX6ULSTARTER

source "board/digi/common/Kconfig"

config SYS_BOARD
	default "ccimx6ulstarter"

config SYS_VENDOR
	default "digi"

config SYS_SOC
	default "mx6"

config SYS_CONFIG_NAME
	default "ccimx6ulstarter"

endif
```

## board/digi/ccimx8mp_dvk/Kconfig
```kconfig
if TARGET_CCIMX8MP_DVK

source "board/digi/common/Kconfig"

config SYS_BOARD
	default "ccimx8mp_dvk"

config SYS_VENDOR
	default "digi"

config SYS_CONFIG_NAME
	default "ccimx8mp_dvk"

endif
```

## board/digi/ccimx8qxp_sbc_express/Kconfig
```kconfig
if TARGET_CCIMX8QXP_SBC_EXPRESS

config SYS_BOARD
	default "ccimx8qxp_sbc_express"

config SYS_VENDOR
	default "digi"

config SYS_CONFIG_NAME
	default "ccimx8qxp_sbc_express"

endif
```

## board/digi/ccimx8x_sbc_express/Kconfig
```kconfig
if TARGET_CCIMX8X_SBC_EXPRESS

source "board/digi/common/Kconfig"

config SYS_BOARD
	default "ccimx8x_sbc_express"

config SYS_VENDOR
	default "digi"

config SYS_CONFIG_NAME
	default "ccimx8x_sbc_express"

endif
```

## board/digi/ccimx93-dvk/Kconfig
```kconfig
if TARGET_CCIMX93_DVK

config SYS_BOARD
	default "ccimx93-dvk"

config SYS_VENDOR
	default "digi"

config SYS_CONFIG_NAME
	default "ccimx93-dvk"

config CCIMX93_DVK_LPDDR4
	bool "Using LPDDR4 Timing and PMIC voltage"
	default y
	select IMX9_LPDDR4X
	help
	  Select the LPDDR4 timing and 1.1V VDDQ

source "board/digi/common/Kconfig"

endif
```

## board/digi/ccmp15-dvk/Kconfig
```kconfig
if TARGET_CCMP15_DVK

source "board/st/common/Kconfig"
source "board/digi/common/Kconfig"

config SYS_BOARD
	default "ccmp15-dvk"

config SYS_VENDOR
	default "digi"

config SYS_CONFIG_NAME
	default "ccmp15-dvk"

endif
```

## board/digi/ccmp15_dvk/Kconfig
```kconfig
if TARGET_CCMP15_DVK

source "board/digi/common/Kconfig"

config MCA
	bool
	default y

config SYS_BOARD
	default "ccmp15_dvk"

config SYS_VENDOR
	default "digi"

config SYS_CONFIG_NAME
	default "ccmp15_dvk"

endif
```

## board/digi/ccmp25-dvk/Kconfig
```kconfig
if TARGET_CCMP25_DVK

config SYS_BOARD
	default "ccmp25-dvk"

config SYS_VENDOR
	default "digi"

config SYS_CONFIG_NAME
	default "ccmp25-dvk"

endif
```

## configs/ccimx6dlsbc256MB_defconfig
```kconfig
CONFIG_ARM=y
CONFIG_ARCH_MX6=y
CONFIG_SYS_TEXT_BASE=0x17800000
CONFIG_TARGET_CCIMX6DLSBC=y
CONFIG_ENV_SIZE=0x4000
CONFIG_ENV_OFFSET=0x1C0000
CONFIG_DM_GPIO=y
CONFIG_NR_DRAM_BANKS=1
CONFIG_ENV_OFFSET_REDUND=0x1E0000
CONFIG_IMX_HAB=y
CONFIG_CSF_SIZE=0x4000
CONFIG_DISTRO_DEFAULTS=y
CONFIG_OF_BOARD_SETUP=y
CONFIG_SYS_EXTRA_OPTIONS="IMX_CONFIG=board/digi/ccimx6/ccimx6dl256MB.cfg,DDR_MB=256"
CONFIG_BOOTDELAY=1
CONFIG_SILENT_CONSOLE=y
# CONFIG_SILENT_CONSOLE_UPDATE_ON_SET is not set
CONFIG_DISPLAY_BOARDINFO_LATE=y
CONFIG_CMD_MEMTEST=y
CONFIG_CMD_GPIO=y
CONFIG_CMD_GPT=y
CONFIG_CMD_I2C=y
CONFIG_CMD_MMC=y
CONFIG_CMD_CACHE=y
CONFIG_CMD_TIME=y
CONFIG_CMD_EXT4_WRITE=y
# CONFIG_ISO_PARTITION is not set
CONFIG_PARTITION_TYPE_GUID=y
CONFIG_OF_CONTROL=y
CONFIG_DEFAULT_DEVICE_TREE="imx6dl-ccimx6sbc"
CONFIG_ENV_IS_IN_MMC=y
CONFIG_SYS_REDUNDAND_ENVIRONMENT=y
CONFIG_RNG_SW_TEST=y
CONFIG_FSL_ESDHC_IMX=y
CONFIG_PHYLIB=y
CONFIG_PHY_MICREL=y
CONFIG_PHY_MICREL_KSZ90X1=y
CONFIG_IMX_THERMAL=y
CONFIG_SHA256=y
CONFIG_OF_LIBFDT_OVERLAY=y
```

## configs/ccimx6dlsbc512MB_defconfig
```kconfig
CONFIG_ARM=y
CONFIG_ARCH_MX6=y
CONFIG_SYS_TEXT_BASE=0x17800000
CONFIG_SECURE_BOOT=y
CONFIG_TARGET_CCIMX6DLSBC=y
CONFIG_DEFAULT_DEVICE_TREE="imx6dl-ccimx6sbc"
CONFIG_DISTRO_DEFAULTS=y
CONFIG_OF_BOARD_SETUP=y
CONFIG_SYS_EXTRA_OPTIONS="IMX_CONFIG=board/digi/ccimx6/ccimx6dl512MB.cfg,DDR_MB=512"
CONFIG_BOOTDELAY=1
CONFIG_SILENT_CONSOLE=y
# CONFIG_SILENT_CONSOLE_UPDATE_ON_SET is not set
CONFIG_CMD_MEMTEST=y
CONFIG_CMD_GPIO=y
CONFIG_CMD_GPT=y
CONFIG_CMD_I2C=y
CONFIG_CMD_MMC=y
CONFIG_CMD_CACHE=y
CONFIG_CMD_TIME=y
CONFIG_CMD_EXT4_WRITE=y
# CONFIG_ISO_PARTITION is not set
CONFIG_PARTITION_TYPE_GUID=y
CONFIG_OF_CONTROL=y
CONFIG_DM_GPIO=y
CONFIG_PHYLIB=y
CONFIG_PHY_MICREL=y
CONFIG_PHY_MICREL_KSZ90X1=y
CONFIG_NETDEVICES=y
CONFIG_IMX_THERMAL=y
```

## configs/ccimx6qsbc_defconfig
```kconfig
CONFIG_ARM=y
CONFIG_ARCH_MX6=y
CONFIG_TEXT_BASE=0x17800000
CONFIG_NR_DRAM_BANKS=1
CONFIG_SYS_MEMTEST_START=0x10000000
CONFIG_SYS_MEMTEST_END=0x10010000
CONFIG_ENV_SIZE=0x4000
CONFIG_ENV_OFFSET=0x1C0000
CONFIG_TARGET_COLIBRI_IMX6=y
CONFIG_DM_GPIO=y
CONFIG_ENV_OFFSET_REDUND=0x1E0000
CONFIG_IMX_HAB=y
CONFIG_CSF_SIZE=0x4000
CONFIG_DEFAULT_DEVICE_TREE="imx6q-ccimx6sbc"
CONFIG_DISTRO_DEFAULTS=y
CONFIG_SYS_EXTRA_OPTIONS="IMX_CONFIG=board/digi/ccimx6/ccimx6q1GB.cfg,DDR_MB=1024"
CONFIG_BOOTDELAY=1
CONFIG_SILENT_CONSOLE=y
# CONFIG_SILENT_CONSOLE_UPDATE_ON_SET is not set
CONFIG_DISPLAY_BOARDINFO_LATE=y
CONFIG_CMD_MEMTEST=y
CONFIG_CMD_GPIO=y
CONFIG_CMD_GPT=y
CONFIG_CMD_I2C=y
CONFIG_CMD_MMC=y
CONFIG_CMD_SATA=y
CONFIG_CMD_CACHE=y
CONFIG_CMD_TIME=y
CONFIG_CMD_EXT4_WRITE=y
# CONFIG_ISO_PARTITION is not set
CONFIG_PARTITION_TYPE_GUID=y
CONFIG_OF_CONTROL=y
CONFIG_ENV_IS_IN_MMC=y
CONFIG_SYS_REDUNDAND_ENVIRONMENT=y
CONFIG_SYS_MMC_ENV_PART=2
CONFIG_SUPPORT_EMMC_BOOT=y
CONFIG_FSL_ESDHC_IMX=y
CONFIG_PHYLIB=y
CONFIG_PHY_MICREL=y
CONFIG_PHY_MICREL_KSZ90X1=y
CONFIG_IMX_THERMAL=y
CONFIG_SHA256=y
CONFIG_OF_LIBFDT_OVERLAY=y
```

## configs/ccimx6ulalvic_defconfig
```kconfig
CONFIG_ARM=y
CONFIG_ARCH_MX6=y
CONFIG_SYS_TEXT_BASE=0x87800000
CONFIG_SYS_MALLOC_LEN=0x1000000
CONFIG_NR_DRAM_BANKS=1
CONFIG_SYS_MEMTEST_START=0x80000000
CONFIG_SYS_MEMTEST_END=0x87ffffff
CONFIG_ENV_SIZE=0x20000
CONFIG_ENV_OFFSET=0x300000
CONFIG_MX6UL=y
CONFIG_TARGET_CCIMX6ULALVIC=y
CONFIG_SYS_I2C_MXC_I2C1=y
#CONFIG_SYS_I2C_MXC_I2C2 is not set
CONFIG_MCA_I2C_BUS=0
CONFIG_MCA_I2C_ADDR=0x7e
CONFIG_CMD_DBOOT=y
CONFIG_CMD_UPDATE=y
CONFIG_DIGI_UBI=y
CONFIG_HAS_HWID=y
CONFIG_DM_GPIO=y
CONFIG_DEFAULT_DEVICE_TREE="imx6ul-ccimx6ulalvic"
CONFIG_BOOTCOUNT_BOOTLIMIT=3
CONFIG_ENV_OFFSET_REDUND=0x300000
CONFIG_IMX_HAB=y
CONFIG_CSF_SIZE=0x4000
CONFIG_DISTRO_DEFAULTS=y
# CONFIG_ANDROID_BOOT_IMAGE is not set
CONFIG_OF_BOARD_SETUP=y
CONFIG_SYS_EXTRA_OPTIONS="DDR_MB=256"
CONFIG_NAND_BOOT=y
CONFIG_BOOTDELAY=1
CONFIG_SILENT_CONSOLE=y
# CONFIG_SILENT_CONSOLE_UPDATE_ON_SET is not set
CONFIG_DISPLAY_BOARDINFO_LATE=y
CONFIG_CRC32_VERIFY=y
CONFIG_CMD_MD5SUM=y
CONFIG_CMD_MEMTEST=y
CONFIG_CMD_GPIO=y
CONFIG_CMD_I2C=y
CONFIG_CMD_MMC=y
CONFIG_CMD_USB=y
CONFIG_CMD_CACHE=y
CONFIG_CMD_TIME=y
CONFIG_CMD_EXT4_WRITE=y
CONFIG_CMD_MTDPARTS=y
CONFIG_CMD_UBI=y
# CONFIG_ISO_PARTITION is not set
CONFIG_PARTITION_TYPE_GUID=y
CONFIG_OF_CONTROL=y
CONFIG_ENV_IS_IN_NAND=y
CONFIG_SYS_REDUNDAND_ENVIRONMENT=y
CONFIG_BOOTCOUNT_LIMIT=y
CONFIG_BOOTCOUNT_ENV=y
CONFIG_USB_FUNCTION_FASTBOOT=y
CONFIG_FASTBOOT_BUF_ADDR=0x80800000
CONFIG_FASTBOOT_BUF_SIZE=0xF000000
CONFIG_FASTBOOT_FLASH=y
CONFIG_MCA_GPIO=y
CONFIG_SYS_I2C_LEGACY=y
CONFIG_SYS_I2C_MXC=y
CONFIG_FSL_USDHC=y
CONFIG_MTD=y
CONFIG_NAND_MXS=y
CONFIG_NAND_MXS_USE_MINIMUM_ECC=y
CONFIG_PHYLIB=y
CONFIG_POWER_LEGACY=y
# CONFIG_SPL_POWER_LEGACY is not set
CONFIG_POWER_I2C=y
CONFIG_DM_RTC=y
CONFIG_RTC_MCA=y
CONFIG_IMX_THERMAL=y
CONFIG_USB=y
CONFIG_USB_GADGET=y
CONFIG_USB_GADGET_MANUFACTURER="FSL"
CONFIG_USB_GADGET_VENDOR_NUM=0x0525
CONFIG_USB_GADGET_PRODUCT_NUM=0xa4a5
CONFIG_CI_UDC=y
CONFIG_SHA256=y
CONFIG_OF_LIBFDT_OVERLAY=y
```

## configs/ccimx6ulsbc1GB_defconfig
```kconfig
CONFIG_ARM=y
CONFIG_TARGET_CCIMX6ULSBC=y
CONFIG_DM=y
CONFIG_IMX_HAB=y
CONFIG_SECURE_BOOT=y
CONFIG_SYS_EXTRA_OPTIONS="IMX_CONFIG=board/digi/ccimx6ul/imximage1GB.cfg,MX6UL,DDR_MB=1024"
CONFIG_DM_THERMAL=y
```

## configs/ccimx6ulsbc_defconfig
```kconfig
CONFIG_ARM=y
CONFIG_ARCH_MX6=y
CONFIG_SYS_TEXT_BASE=0x87800000
CONFIG_SECURE_BOOT=y
CONFIG_MODULE_FUSE=y
CONFIG_TARGET_CCIMX6ULSBC=y
CONFIG_DEFAULT_DEVICE_TREE="imx6ul-ccimx6ulsbc"
CONFIG_DISTRO_DEFAULTS=y
CONFIG_OF_BOARD_SETUP=y
CONFIG_SYS_EXTRA_OPTIONS="IMX_CONFIG=board/digi/ccimx6ul/imximage.cfg,DDR_MB=256"
CONFIG_NAND_BOOT=y
CONFIG_BOOTDELAY=1
CONFIG_SILENT_CONSOLE=y
# CONFIG_SILENT_CONSOLE_UPDATE_ON_SET is not set
CONFIG_CMD_MEMTEST=y
CONFIG_CMD_GPIO=y
CONFIG_CMD_GPT=y
CONFIG_CMD_I2C=y
CONFIG_CMD_MMC=y
CONFIG_CMD_USB=y
CONFIG_CMD_CACHE=y
CONFIG_CMD_TIME=y
CONFIG_CMD_EXT4_WRITE=y
CONFIG_CMD_UBI=y
# CONFIG_ISO_PARTITION is not set
CONFIG_PARTITION_TYPE_GUID=y
CONFIG_OF_CONTROL=y
CONFIG_DM_GPIO=y
CONFIG_PHYLIB=y
CONFIG_IMX_THERMAL=y
```

## configs/ccimx8mm_dvk_defconfig
```kconfig
CONFIG_ARM=y
CONFIG_SPL_SYS_ICACHE_OFF=y
CONFIG_SPL_SYS_DCACHE_OFF=y
CONFIG_ARCH_IMX8M=y
CONFIG_TEXT_BASE=0x40200000
CONFIG_SYS_MALLOC_LEN=0x2000000
CONFIG_SPL_GPIO=y
CONFIG_SPL_LIBCOMMON_SUPPORT=y
CONFIG_SPL_LIBGENERIC_SUPPORT=y
CONFIG_NR_DRAM_BANKS=1
CONFIG_ENV_SIZE=0x4000
CONFIG_ENV_OFFSET=0x1C0000
CONFIG_SYS_I2C_MXC_I2C1=y
CONFIG_SYS_I2C_MXC_I2C2=y
CONFIG_SYS_I2C_MXC_I2C3=y
CONFIG_MCA_I2C_BUS=0
CONFIG_MCA_I2C_ADDR=0x63
CONFIG_CMD_DBOOT=y
CONFIG_CMD_UPDATE=y
CONFIG_HAS_HWID=y
CONFIG_DM_GPIO=y
CONFIG_DEFAULT_DEVICE_TREE="ccimx8mm-dvk"
CONFIG_SPL_TEXT_BASE=0x7E1000
CONFIG_TARGET_CCIMX8MM_DVK=y
CONFIG_DM_RESET=y
CONFIG_SPL_MMC=y
CONFIG_SPL_SERIAL=y
CONFIG_SPL_DRIVERS_MISC=y
CONFIG_BOOTCOUNT_BOOTLIMIT=0
CONFIG_SPL_STACK=0x91FFF0
CONFIG_SPL=y
CONFIG_ENV_OFFSET_REDUND=0x1E0000
CONFIG_IMX_OPTEE=y
CONFIG_IMX_BOOTAUX=y
CONFIG_IMX_HAB=y
CONFIG_SYS_LOAD_ADDR=0x40480000
CONFIG_SYS_MEMTEST_START=0x40000000
CONFIG_SYS_MEMTEST_END=0x5fffffff
CONFIG_REMAKE_ELF=y
CONFIG_SYS_MONITOR_LEN=524288
CONFIG_FIT=y
CONFIG_FIT_EXTERNAL_OFFSET=0x3000
CONFIG_SPL_LOAD_FIT=y
CONFIG_OF_BOARD_SETUP=y
CONFIG_OF_SYSTEM_SETUP=y
CONFIG_DISTRO_DEFAULTS=y
# CONFIG_USE_BOOTCOMMAND is not set
CONFIG_DEFAULT_FDT_FILE="ccimx8mm-dvk.dtb"
CONFIG_SILENT_CONSOLE=y
# CONFIG_SILENT_CONSOLE_UPDATE_ON_SET is not set
CONFIG_SILENT_CONSOLE_UPDATE_ON_RELOC=y
CONFIG_BOARD_EARLY_INIT_F=y
CONFIG_BOARD_LATE_INIT=y
CONFIG_SPL_MAX_SIZE=0x34000
CONFIG_SPL_HAS_BSS_LINKER_SECTION=y
CONFIG_SPL_BSS_START_ADDR=0x00910000
CONFIG_SPL_BSS_MAX_SIZE=0x2000
CONFIG_SPL_BOARD_INIT=y
CONFIG_SPL_LEGACY_IMAGE_FORMAT=y
# CONFIG_SPL_SHARES_INIT_SP_ADDR is not set
CONFIG_SYS_SPL_MALLOC=y
CONFIG_HAS_CUSTOM_SPL_MALLOC_START=y
CONFIG_CUSTOM_SYS_SPL_MALLOC_ADDR=0x42200000
CONFIG_SYS_SPL_MALLOC_SIZE=0x80000
CONFIG_SYS_MMCSD_RAW_MODE_U_BOOT_USE_SECTOR=y
CONFIG_SYS_MMCSD_RAW_MODE_U_BOOT_SECTOR=0x300
CONFIG_SPL_I2C=y
CONFIG_SPL_POWER=y
CONFIG_SPL_USB_HOST=y
CONFIG_SPL_USB_GADGET=y
CONFIG_SPL_USB_SDP_SUPPORT=y
CONFIG_SYS_CBSIZE=2048
CONFIG_CMD_BOOTZ=y
CONFIG_CMD_ASKENV=y
CONFIG_CMD_MD5SUM=y
CONFIG_CMD_MEMTEST=y
CONFIG_CMD_FUSE=y
CONFIG_CMD_GPIO=y
CONFIG_CMD_I2C=y
CONFIG_CMD_MMC=y
CONFIG_CMD_USB=y
CONFIG_CMD_USB_MASS_STORAGE=y
CONFIG_CMD_BOOTCOUNT=y
CONFIG_CMD_CACHE=y
CONFIG_CMD_TIME=y
CONFIG_CMD_REGULATOR=y
CONFIG_CMD_EXT4_WRITE=y
# CONFIG_ISO_PARTITION is not set
CONFIG_PARTITION_TYPE_GUID=y
CONFIG_OF_CONTROL=y
CONFIG_ENV_IS_IN_MMC=y
CONFIG_SYS_REDUNDAND_ENVIRONMENT=y
CONFIG_SYS_RELOC_GD_ENV_ADDR=y
CONFIG_SYS_MMC_ENV_PART=2
CONFIG_REGMAP=y
CONFIG_SYSCON=y
CONFIG_BOOTCOUNT_LIMIT=y
CONFIG_DM_BOOTCOUNT=y
CONFIG_DM_BOOTCOUNT_RTC=y
CONFIG_CLK_IMX8MM=y
CONFIG_USB_FUNCTION_FASTBOOT=y
CONFIG_FASTBOOT_BUF_ADDR=0x42800000
CONFIG_FASTBOOT_BUF_SIZE=0x40000000
CONFIG_FASTBOOT_FLASH=y
CONFIG_MCA_GPIO=y
CONFIG_MXC_GPIO=y
CONFIG_DM_I2C=y
CONFIG_SPL_SYS_I2C_LEGACY=y
CONFIG_SUPPORT_EMMC_BOOT=y
CONFIG_MMC_IO_VOLTAGE=y
CONFIG_MMC_UHS_SUPPORT=y
CONFIG_MMC_HS400_ES_SUPPORT=y
CONFIG_MMC_HS400_SUPPORT=y
CONFIG_FSL_USDHC=y
CONFIG_PHYLIB=y
CONFIG_PHY_ATHEROS=y
CONFIG_PHY_GIGE=y
CONFIG_FEC_MXC=y
CONFIG_PINCTRL=y
CONFIG_PINCTRL_IMX8M=y
CONFIG_SPL_POWER_LEGACY=y
CONFIG_POWER_DOMAIN=y
CONFIG_IMX8M_POWER_DOMAIN=y
CONFIG_IMX8M_BLK_CTRL=y
CONFIG_POWER_BD71837=y
CONFIG_POWER_PCA9450=y
CONFIG_DM_REGULATOR=y
CONFIG_DM_REGULATOR_FIXED=y
CONFIG_DM_REGULATOR_GPIO=y
CONFIG_SPL_POWER_I2C=y
CONFIG_DM_RTC=y
CONFIG_RTC_MCA=y
CONFIG_MXC_UART=y
CONFIG_DM_THERMAL=y
CONFIG_IMX_TMU=y
CONFIG_USB=y
CONFIG_USB_EHCI_HCD=y
CONFIG_USB_MAX_CONTROLLER_COUNT=2
CONFIG_USB_HUB_DEBOUNCE_TIMEOUT=2000
CONFIG_USB_GADGET=y
CONFIG_USB_GADGET_MANUFACTURER="FSL"
CONFIG_USB_GADGET_VENDOR_NUM=0x1fc9
CONFIG_USB_GADGET_PRODUCT_NUM=0x0152
CONFIG_CI_UDC=y
CONFIG_SDP_LOADADDR=0x40400000
CONFIG_OF_LIBFDT_OVERLAY=y
# CONFIG_EFI_LOADER is not set
CONFIG_VIDEO_IMX_SEC_DSI=y
CONFIG_VIDEO=y
CONFIG_BMP_16BPP=y
CONFIG_BMP_24BPP=y
CONFIG_BMP_32BPP=y
CONFIG_VIDEO_MXS=y
CONFIG_VIDEO_LOGO=y
CONFIG_VIDEO_LT8912=y
CONFIG_SYS_WHITE_ON_BLACK=y
CONFIG_SPLASH_SCREEN=y
CONFIG_SPLASH_SCREEN_ALIGN=y
CONFIG_CMD_BMP=y
```
